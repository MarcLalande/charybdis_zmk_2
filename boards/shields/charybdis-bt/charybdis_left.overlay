#include "charybdis.dtsi"
#include "charybdis_pmw3610.dtsi"

&kscan0 {
	compatible = "zmk,kscan-gpio-matrix";
	
	col-gpios
		= <&gpio0 2 (GPIO_ACTIVE_HIGH | GPIO_PULL_DOWN)>   // Your pin: gpio0 2
		, <&gpio0 29 (GPIO_ACTIVE_HIGH | GPIO_PULL_DOWN)>  // Your pin: gpio0 29
		, <&gpio0 9 (GPIO_ACTIVE_HIGH | GPIO_PULL_DOWN)>   // Your pin: gpio0 9
		, <&gpio1 0 (GPIO_ACTIVE_HIGH | GPIO_PULL_DOWN)>   // Your pin: gpio1 0
		, <&gpio0 11 (GPIO_ACTIVE_HIGH | GPIO_PULL_DOWN)>  // Your pin: gpio0 11
		, <&gpio1 4 (GPIO_ACTIVE_HIGH | GPIO_PULL_DOWN)>   // Your pin: gpio1 4
		;
	row-gpios
   	        = <&gpio0 31 GPIO_ACTIVE_HIGH>   // Your pin: gpio0 31
                , <&gpio1 15 GPIO_ACTIVE_HIGH>   // Your pin: gpio1 15
                , <&gpio0 24 GPIO_ACTIVE_HIGH>   // Your pin: gpio0 24
                , <&gpio0 22 GPIO_ACTIVE_HIGH>   // Your pin: gpio0 22
                , <&gpio1 6 GPIO_ACTIVE_HIGH>    // Your pin: gpio1 6
                ;
};

// https://github.com/badjeff/zmk-pmw3610-driver
/ {
  trackball_listener {
    compatible = "zmk,input-listener";
    device = <&trackball>;
  };
};
